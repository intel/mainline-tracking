## Documentation/devicetree/bindings/arm/intel,thunderbay.yaml
```yaml
# SPDX-License-Identifier: (GPL-2.0-only OR BSD-2-Clause)
%YAML 1.2
---
$id: http://devicetree.org/schemas/arm/intel,thunderbay.yaml#
$schema: http://devicetree.org/meta-schemas/core.yaml#

title: Thunder Bay platform device tree bindings

maintainers:
  - Demakkanavar, Kenchappa <kenchappa.demakkanavar@intel.com>

properties:
  compatible:
    items:
      - enum:
          - intel,thunderbay
      - const: intel,thunderbay

additionalProperties: true

...
```

## Documentation/devicetree/bindings/dma/snps,dw-axi-dmac.yaml
```yaml
# SPDX-License-Identifier: (GPL-2.0-only OR BSD-2-Clause)
%YAML 1.2
---
$id: http://devicetree.org/schemas/dma/snps,dw-axi-dmac.yaml#
$schema: http://devicetree.org/meta-schemas/core.yaml#

title: Synopsys DesignWare AXI DMA Controller

maintainers:
  - Eugeniy Paltsev <Eugeniy.Paltsev@synopsys.com
  - Sia, Jee Heng <jee.heng.sia@intel.com>

description: |
 Synopsys DesignWare AXI DMA Controller DT Binding

properties:
  compatible:
    enum:
      - snps,axi-dma-1.01a
      - intel,kmb-axi-dma

  reg:
    items:
      - description: Address range of the DMAC registers.

  reg-names:
    items:
      - const: axidma_ctrl_regs
      - const: axidma_apb_regs

  interrupts:
    maxItems: 1

  clocks:
    items:
      - description: Bus Clock
      - description: Module Clock

  clock-names:
    items:
      - const: core-clk
      - const: cfgr-clk

  '#dma-cells':
    const: 1

  dma-channels:
    description: |
      Number of channels supported by hardware.

  snps,dma-masters:
    description: |
      Number of AXI masters supported by the hardware.
    allOf:
      - $ref: /schemas/types.yaml#/definitions/uint32
      - enum: [1, 2]
        default: 2

  snps,data-width:
    description: |
      AXI data width supported by hardware.
      (0 - 8bits, 1 - 16bits, 2 - 32bits, ..., 6 - 512bits)
    allOf:
      - $ref: /schemas/types.yaml#/definitions/uint32
      - enum: [0, 1, 2, 3, 4, 5, 6]
        default: 4

  snps,priority:
    description: |
      Channel priority specifier associated with the DMA channels.
    allOf:
      - $ref: /schemas/types.yaml#/definitions/uint32-array
      - minItems: 1
        maxItems: 8
        default: [0, 1, 2, 3]

  snps,block-size:
    description: |
      Channel block size specifier associated with the DMA channels.
    allOf:
      - $ref: /schemas/types.yaml#/definitions/uint32-array
      - minItems: 1
        maxItems: 8
        default: [4096, 4096, 4096, 4096]

  snps,axi-max-burst-len:
    description: |
      Restrict master AXI burst length by value specified in this property.
      If this property is missing the maximum AXI burst length supported by
      DMAC is used. [1:256]
    allOf:
      - $ref: /schemas/types.yaml#/definitions/uint32
        default: 16

required:
  - compatible
  - reg
  - clocks
  - clock-names
  - interrupts
  - '#dma-cells'
  - dma-channels
  - snps,dma-masters
  - snps,data-width
  - snps,priority
  - snps,block-size

examples:
  - |
     #include <dt-bindings/interrupt-controller/arm-gic.h>
     #include <dt-bindings/interrupt-controller/irq.h>
     /* example with snps,dw-axi-dmac */
     dmac: dma-controller@80000 {
         compatible = "snps,axi-dma-1.01a";
         reg = <0x80000 0x400>;
         clocks = <&core_clk>, <&cfgr_clk>;
         clock-names = "core-clk", "cfgr-clk";
         interrupt-parent = <&intc>;
         interrupts = <27>;
         #dma-cells = <1>;
         dma-channels = <4>;
         snps,dma-masters = <2>;
         snps,data-width = <3>;
         snps,block-size = <4096 4096 4096 4096>;
         snps,priority = <0 1 2 3>;
         snps,axi-max-burst-len = <16>;
     };

  - |
     #include <dt-bindings/interrupt-controller/arm-gic.h>
     #include <dt-bindings/interrupt-controller/irq.h>
     /* example with intel,kmb-axi-dma */
     #define KEEM_BAY_PSS_AXI_DMA
     #define KEEM_BAY_PSS_APB_AXI_DMA
     axi_dma: dma@28000000 {
         compatible = "intel,kmb-axi-dma";
         reg = <0x28000000 0x1000 0x20250000 0x24>;
         reg-names = "axidma_ctrl_regs", "axidma_apb_regs";
         interrupts = <GIC_SPI 88 IRQ_TYPE_LEVEL_HIGH>;
         clock-names = "core-clk", "cfgr-clk";
         clocks = <&scmi_clk KEEM_BAY_PSS_AXI_DMA>, <&scmi_clk KEEM_BAY_PSS_APB_AXI_DMA>;
         #dma-cells = <1>;
         dma-channels = <8>;
         snps,dma-masters = <1>;
         snps,data-width = <4>;
         snps,priority = <0 0 0 0 0 0 0 0>;
         snps,block-size = <1024 1024 1024 1024 1024 1024 1024 1024>;
         snps,axi-max-burst-len = <16>;
     };
```

## Documentation/devicetree/bindings/mailbox/intel,keembay-ipc-mailbox.yaml
```yaml
# SPDX-License-Identifier: (GPL-2.0-only OR BSD-2-Clause)
# Copyright (c) 2020 Intel Corporation
%YAML 1.2
---
$id: "http://devicetree.org/schemas/mailbox/intel,keembay-ipc-mailbox.yaml#"
$schema: "http://devicetree.org/meta-schemas/core.yaml#"

title: Intel Keem Bay IPC mailbox

maintainers:
  - Daniele Alessandrelli <daniele.alessandrelli@intel.com>

description: |
  Intel VPU SoCs like Keem Bay have hardware FIFOs to enable Inter-Processor
  Communication (IPC) between the CPU and the VPU.

  Specifically, there is one HW FIFO for the CPU (aka Application Processor -
  AP) and one for the VPU. Each FIFO can hold 128 entries of 32 bits each. A
  "FIFO-not-empty" interrupt is raised every time there is at least a message
  in the FIFO. The CPU FIFO raises interrupts to the CPU, while the VPU FIFO
  raises interrupts to VPU. When the CPU wants to send a message to the VPU it
  writes to the VPU FIFO, similarly, when the VPU want to send a message to the
  CPU, it writes to the CPU FIFO.

  Refer to ./mailbox.txt for generic information about mailbox device-tree
  bindings.

properties:
  compatible:
    const: intel,keembay-ipc-mailbox

  reg:
    items:
      - description: The CPU FIFO registers
      - description: The VPU FIFO registers

  reg-names:
    items:
      - const: cpu_fifo
      - const: vpu_fifo

  interrupts:
    items:
      - description: CPU FIFO-not-empty interrupt

  "#mbox-cells":
    const: 1

required:
  - compatible
  - reg
  - reg-names
  - interrupts
  - "#mbox-cells"

additionalProperties: false

examples:
  - |
    #include <dt-bindings/interrupt-controller/irq.h>
    #include <dt-bindings/interrupt-controller/arm-gic.h>
    keembay_ipc_mailbox@203300f0 {
        compatible = "intel,keembay-ipc-mailbox";
        #mbox-cells = <1>;
        reg = <0x203300f0 0x310>,
              <0x208200f0 0x310>;
        reg-names = "cpu_fifo", "vpu_fifo";
        interrupts = <GIC_SPI 12 IRQ_TYPE_LEVEL_HIGH>;
    };
```

## Documentation/devicetree/bindings/misc/intel,vpu.yaml
```yaml
# SPDX-License-Identifier: (GPL-2.0-only OR BSD-2-Clause)
%YAML 1.2
---
$id: http://devicetree.org/schemas/arm/intel,vpu.yaml#
$schema: http://devicetree.org/meta-schemas/core.yaml#

title: Intel Thunder Bay VPU memory mapping

maintainers:
  - Demakkanavar, Kenchappa <kenchappa.demakkanavar@intel.com>

description: |+
  Intel Thunder Bay VPU memory mapping device tree binding. This mapping
  enables VPU to access DDR.

properties:
  compatible:
    enum:
      - const: intel,vpu

  intel,smmu_params:
    items:
      - description: vpu address space mapping start(1 cell),
		      ddr address space start(2 cells),
		      size(1 cell) and
		      memory access properties(1 cell)

required:
  - compatible
  - intel,smmu_params

additionalProperties: false

+examples:
  - |
    vpu0_mm@0 {
	compatible = "intel,vpu";

	/* 2-GB SOC level memory - DDR */
	intel,smmu_params = <0x80000000 0x8 0x80000000 0x80000000 (IOMMU_READ|IOMMU_WRITE)>;
	iommus = <&vpu_smmu0 47>;
    };
```

## Documentation/devicetree/bindings/soc/intel/intel,keembay-vpu-ipc.yaml
```yaml
# SPDX-License-Identifier: (GPL-2.0 OR BSD-2-Clause)
# Copyright (C) 2018-2021 Intel Corporation
%YAML 1.2
---
$id: "http://devicetree.org/schemas/soc/intel/intel,keembay-vpu-ipc.yaml#"
$schema: "http://devicetree.org/meta-schemas/core.yaml#"

title: Intel Keem Bay VPU IPC

maintainers:
  - Daniele Alessandrelli <daniele.alessandrelli@intel.com>
  - Paul Murphy <paul.j.murphy@intel.com>
  - Mark Gross <mgross@linux.intel.coom>

description:
  This binding provides support for the Vision Processing Unit (VPU) found on
  the Intel Keem Bay SoC.

  The VPU is started and controlled by the SoC CPU, which is in charge of
  loading the VPU firmware. The SoC CPU can communicate with the VPU firmware
  using an Inter-Processor Communication (IPC) mechanism named Keem Bay IPC.

properties:
  compatible:
    const: intel,keembay-vpu-ipc

  reg:
    items:
      - description: NCE WDT registers
      - description: NCE TIM_GEN_CONFIG registers
      - description: MSS WDT registers
      - description: MSS TIM_GEN_CONFIG registers

  reg-names:
    items:
      - const: nce_wdt
      - const: nce_tim_cfg
      - const: mss_wdt
      - const: mss_tim_cfg

  memory-region:
    items:
      - description:
          Reserved memory region used where the VPU firmware is be loaded.
      - description:
          Reserved memory region where the VPU firmware X.509 certificate is to
          be loaded.
      - description:
          Reserved memory region used by the VPU to allocate its own IPC
          packets.
      - description:
          Reserved memory region used by the CPU to allocate its own IPC
          packets.

  memory-region-names:
    items:
      - const: "fw-area"
      - const: "x509-area"
      - const: "ipc-mem-vpu"
      - const: "ipc-mem-cpu"

  clocks:
    items:
      - description: cpu clock
      - description: pll 0 out 0 rate
      - description: pll 0 out 1 rate
      - description: pll 0 out 2 rate
      - description: pll 0 out 3 rate
      - description: pll 1 out 0 rate
      - description: pll 1 out 1 rate
      - description: pll 1 out 2 rate
      - description: pll 1 out 3 rate
      - description: pll 2 out 0 rate
      - description: pll 2 out 1 rate
      - description: pll 2 out 2 rate
      - description: pll 2 out 3 rate

  clock-names:
    items:
      - const: cpu_clock
      - const: pll_0_out_0
      - const: pll_0_out_1
      - const: pll_0_out_2
      - const: pll_0_out_3
      - const: pll_1_out_0
      - const: pll_1_out_1
      - const: pll_1_out_2
      - const: pll_1_out_3
      - const: pll_2_out_0
      - const: pll_2_out_1
      - const: pll_2_out_2
      - const: pll_2_out_3

  interrupts:
    items:
      - description: Number of NCE sub-system WDT timeout IRQ
      - description: Number of MSS sub-system WDT timeout IRQ

  interrupt-names:
    items:
      - const: nce_wdt
      - const: mss_wdt

  mboxes:
    description: Keem Bay IPC Mailbox.

  intel,keembay-vpu-ipc-id:
    $ref: "/schemas/types.yaml#/definitions/uint32"
    description: The VPU ID to be passed to the VPU firmware.

required:
  - compatible
  - reg
  - reg-names
  - memory-region
  - memory-region-names
  - clocks
  - clock-names
  - interrupts
  - interrupt-names
  - mboxes
  - intel,keembay-vpu-ipc-id

additionalProperties: false

examples:
  - |
    #include <dt-bindings/interrupt-controller/arm-gic.h>
    vpu-ipc@3f00209c {
        compatible = "intel,keembay-vpu-ipc";
        reg = <0x3f00209c 0x10>,
              <0x3f003008 0x4>,
              <0x2082009c 0x10>,
              <0x20821008 0x4>;
        reg-names = "nce_wdt",
                    "nce_tim_cfg",
                    "mss_wdt",
                    "mss_tim_cfg";
        memory-region = <&vpu_reserved>,
                        <&vpu_x509_reserved>,
                        <&ipc_vpu_reserved>,
                        <&ipc_cpu_reserved>;
        memory-region-names = "fw-area",
                              "x509-area",
                              "ipc-mem-vpu",
                              "ipc-mem-cpu";
        clocks = <&scmi_clk 0>,
                 <&scmi_clk 0>,
                 <&scmi_clk 1>,
                 <&scmi_clk 2>,
                 <&scmi_clk 3>,
                 <&scmi_clk 4>,
                 <&scmi_clk 5>,
                 <&scmi_clk 6>,
                 <&scmi_clk 7>,
                 <&scmi_clk 8>,
                 <&scmi_clk 9>,
                 <&scmi_clk 10>,
                 <&scmi_clk 11>;
        clock-names = "cpu_clock",
                      "pll_0_out_0", "pll_0_out_1",
                      "pll_0_out_2", "pll_0_out_3",
                      "pll_1_out_0", "pll_1_out_1",
                      "pll_1_out_2", "pll_1_out_3",
                      "pll_2_out_0", "pll_2_out_1",
                      "pll_2_out_2", "pll_2_out_3";
        interrupts = <GIC_SPI 63 IRQ_TYPE_LEVEL_HIGH>,
                     <GIC_SPI 47 IRQ_TYPE_LEVEL_HIGH>;
        interrupt-names = "nce_wdt", "mss_wdt";
        mboxes = <&keembay_ipc_mbox 0>;
        intel,keembay-vpu-ipc-id = <0>;
    };
```

## drivers/gpu/drm/hantro_driver/Kconfig
```kconfig
config DRM_HANTRO
        tristate "Hantro Driver"
        depends on DRM
        select DRM_PANEL
        select DRM_KMS_HELPER
        help
          Choose this option if your system supports Hantro Driver
          for TBH ARM Media. This driver supports video and JPEG
          encode/decode.
```

## drivers/media/platform/intel/Kconfig
```kconfig
config INTEL_IPU7_FPGA_PDATA
	bool "Enable built in platform data for ipu7 fpga"
	depends on VIDEO_INTEL_IPU7
	help
	Pre-ACPI system platform data is compiled inside kernel.

	This platform data is only used for PSS stage software
	development and mainly used for pixter or sensor enablement
	without ACPI support.

config INTEL_IPU7_ACPI
	tristate "Enable IPU ACPI driver"
	default VIDEO_INTEL_IPU7
	depends on I2C
	depends on ACPI
	help
	  Driver to read ACPI data from BIOS

	  This driver is used to read ACPI data from BIOS
```

## drivers/misc/emc2103/Kconfig
```kconfig
#
# kConfig for KeemBay Thermal Linux driver
#

config HOST_KMB_EMC
	tristate "IA Host Keembay emc Driver"
	depends on SENSORS_EMC2103 != m
	default m
	help
	  Enable this option to get the KMB emc in the IA host
```
