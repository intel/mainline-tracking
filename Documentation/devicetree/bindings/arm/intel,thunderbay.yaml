## drivers/misc/intel_tsens/Kconfig
```kconfig
# Copyright (C) 2020 Intel Corporation
# SPDX-License-Identifier: GPL-2.0-only

config INTEL_TSENS_LOCAL_HOST
	bool "Temperature sensor driver for Intel tsens"
	depends on HAS_IOMEM
	select THERMAL
	help
	  This option enables tsens thermal local Host driver.

	  This driver is used for reporting thermal data via thermal
	  framework.
	  Enable this option if you want to have support for thermal
	  management controller.
	  Say Y if using a processor that includes the Intel VPU such as
	  Keem Bay.  If unsure, say N.

config INTEL_TSENS_I2C_SLAVE
	bool "I2C slave driver for Intel tsens"
	depends on INTEL_TSENS_LOCAL_HOST
	depends on I2C=y && I2C_SLAVE
	help
	  This option enables tsens I2C slave driver.

	  This driver is used for reporting thermal data via I2C
	  SMBUS to remote host.
	  Enable this option if you want to have support for thermal
	  management controller.
	  Say Y if using a processor that includes the Intel VPU such as
	  Keem Bay.  If unsure, say N.

config KEEMBAY_THERMAL
	tristate "Temperature sensor driver for Intel Keem Bay"
	depends on INTEL_TSENS_LOCAL_HOST && ARCH_KEEMBAY
	help
	  Enable this option if you want to have support for Keem Bay
	  thermal management sensors.

	  This driver is used for reading onchip temperature sensor
	  values from Keem Bay SoC.
	  Say Y if using a processor that includes the Intel VPU such as
	  Keem Bay.  If unsure, say N.

config INTEL_TSENS_IA_HOST
	tristate "Temperature sensor driver for Intel tsens remote host"
	depends on I2C && THERMAL
	depends on I2C_SMBUS
	help
	  This option enables tsens i2c and thermal local Host driver.

	  This driver is used for reading thermal data via I2C SMBUS
	  and registers itself to thermal framework, which can be
	  used by thermal daemon in remote IA host
	  Say Y if using a processor that includes the Intel VPU such as
	  Keem Bay.  If unsure, say N.

config THUNDERBAY_THERMAL
	tristate "Temperature sensor driver for intel thunderbay"
	depends on INTEL_TSENS_LOCAL_HOST
	help
	  Enable this option if you want to have support for thunderbay
	  thermal management sensors.

	  This driver is used for reading onchip temperature sensor
	  values from thunderbay SoC.

config MOVIDIUS_VPU_COOLING
	tristate "Movidius VPU Cooling Driver"
	depends on XLINK_CORE
	help
	Enable this option to support vpu cooling driver for Movidius VPU
```

## drivers/misc/issei/Kconfig
```kconfig
# SPDX-License-Identifier: GPL-2.0
# Copyright (C) 2023-2026 Intel Corporation
config INTEL_SSEI
	tristate "Intel Silicon Security Engine Interface"
	help
	  The ISSEI (Intel Silicon Security Engine Interface)
	  subsystem provides a communication channel between the host and the
	  Silicon Security Engine.
	  Enable this driver to get SPDM and other features on Intel client CPUs
	  released in 2024 (Lunar Lake) or later.

	  If selected, the /dev/isseiX device will be created.
	  If in doubt, select N.
```

## drivers/misc/mei/Kconfig.rej
```kconfig
diff a/drivers/misc/mei/Kconfig b/drivers/misc/mei/Kconfig	(rejected hunks)
@@ -57,3 +57,4 @@ config INTEL_MEI_VIRTIO
 	  device over virtio.
 
 source "drivers/misc/mei/hdcp/Kconfig"
+source "drivers/misc/mei/dal/Kconfig"
```

## drivers/misc/vpu/Kconfig
```kconfig
config VPU
	tristate "Support for VPU memory mapping driver"
	help
	  This driver enables VPU to access DDR memory.
```

## drivers/misc/xlink-net/Kconfig
```kconfig
config XLINK_NET
	tristate "Support for XLINKNET"
	default m
	depends on XLINK_CORE
	help
		XLINK_NET enables the network interface over xlink pcie module.
		Choose M here to compile this driver as a module,
		name is xlink_net.
		Choose Y here to compile this driver as a default module in build.


config XLINKNET_REMOTEHOST
	tristate "Support for XLINKNET for remote host"
	depends on XLINK_CORE && XLINK_NET=n
	help
		XLINKNET_REMOTEHOST enables the network interface over
		xlink pcie in the host side.

		Choose M here to compile this driver as a module.
		Choose Y here to compile this driver
		as a default module in build.
```

## drivers/soc/intel/Kconfig
```kconfig
# SPDX-License-Identifier: GPL-2.0-only
#
# Keem Bay SoC drivers
#

menu "Intel SoC drivers"

config KEEMBAY_VPU_IPC
	tristate "Intel Keem Bay VPU IPC Driver"
	depends on INTEL_KEEMBAY_IPC_MBOX
	depends on ARCH_KEEMBAY || ARCH_THUNDERBAY || (ARM64 && COMPILE_TEST)
	depends on HAVE_ARM_SMCCC
	help
	  This option enables support for loading and communicating with
	  the firmware on the Vision Processing Unit (VPU) of the Keem Bay
	  SoC.

	  Select this if you are compiling the Kernel for an Intel SoC that
	  includes the Intel Vision Processing Unit (VPU) such as Keem Bay.

endmenu
```
